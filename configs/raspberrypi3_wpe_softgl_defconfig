## configs/raspberrypi3_wpe_softgl_defconfig
```kconfig
BR2_arm=y
BR2_cortex_a7=y
BR2_ARM_FPU_NEON_VFPV4=y
BR2_ARM_INSTRUCTIONS_THUMB2=y
BR2_CCACHE=y
BR2_TOOLCHAIN_BUILDROOT_GLIBC=y
BR2_PACKAGE_HOST_LINUX_HEADERS_CUSTOM_4_4=y
BR2_GLIBC_VERSION_2_24=y
BR2_BINUTILS_VERSION_2_27_X=y
BR2_GCC_VERSION_6_X=y
BR2_TOOLCHAIN_BUILDROOT_CXX=y
BR2_TARGET_GENERIC_HOSTNAME="wpe"
BR2_TARGET_GENERIC_ISSUE="Welcome to Buildroot-WPE"
BR2_TARGET_GENERIC_PASSWD_SHA512=y
BR2_ROOTFS_DEVICE_CREATION_DYNAMIC_EUDEV=y
BR2_TARGET_GENERIC_ROOT_PASSWD="root"
BR2_SYSTEM_DHCP="eth0"
BR2_ROOTFS_POST_BUILD_SCRIPT="board/raspberrypi3/post-build.sh"
BR2_LINUX_KERNEL=y
BR2_LINUX_KERNEL_CUSTOM_GIT=y
BR2_LINUX_KERNEL_CUSTOM_REPO_URL="https://github.com/raspberrypi/linux.git"
BR2_LINUX_KERNEL_CUSTOM_REPO_VERSION="1ebe8d4a4c96cd6a90805c74233a468854960f67"
BR2_LINUX_KERNEL_DEFCONFIG="bcm2709"
BR2_LINUX_KERNEL_LZ4=y
BR2_LINUX_KERNEL_DTS_SUPPORT=y
BR2_LINUX_KERNEL_INTREE_DTS_NAME="bcm2710-rpi-3-b bcm2709-rpi-2-b"
BR2_PACKAGE_BUSYBOX_SMP=y
BR2_PACKAGE_BUSYBOX_WATCHDOG=y
BR2_PACKAGE_ALSA_UTILS=y
BR2_PACKAGE_ALSA_UTILS_AMIXER=y
BR2_PACKAGE_ALSA_UTILS_APLAY=y
BR2_PACKAGE_AUMIX=y
BR2_PACKAGE_GSTREAMER1=y
BR2_PACKAGE_GSTREAMER1_GIT=y
BR2_PACKAGE_GST1_PLUGINS_BASE_PLUGIN_APP=y
BR2_PACKAGE_GST1_PLUGINS_BASE_PLUGIN_AUDIORATE=y
BR2_PACKAGE_GST1_PLUGINS_BASE_PLUGIN_AUDIOTESTSRC=y
BR2_PACKAGE_GST1_PLUGINS_BASE_PLUGIN_ENCODING=y
BR2_PACKAGE_GST1_PLUGINS_BASE_PLUGIN_VIDEOCONVERT=y
BR2_PACKAGE_GST1_PLUGINS_BASE_PLUGIN_VIDEOTESTSRC=y
BR2_PACKAGE_GST1_PLUGINS_BASE_PLUGIN_VIDEORATE=y
BR2_PACKAGE_GST1_PLUGINS_BASE_PLUGIN_ALSA=y
BR2_PACKAGE_GST1_PLUGINS_BASE_PLUGIN_OGG=y
BR2_PACKAGE_GST1_PLUGINS_BASE_PLUGIN_OPUS=y
BR2_PACKAGE_GST1_PLUGINS_BASE_PLUGIN_THEORA=y
BR2_PACKAGE_GST1_PLUGINS_BASE_PLUGIN_VORBIS=y
BR2_PACKAGE_GST1_PLUGINS_GOOD_BZ2=y
BR2_PACKAGE_GST1_PLUGINS_GOOD_ZLIB=y
BR2_PACKAGE_GST1_PLUGINS_GOOD_PLUGIN_AUDIOPARSERS=y
BR2_PACKAGE_GST1_PLUGINS_GOOD_PLUGIN_AUTODETECT=y
BR2_PACKAGE_GST1_PLUGINS_GOOD_PLUGIN_DTMF=y
BR2_PACKAGE_GST1_PLUGINS_GOOD_PLUGIN_ICYDEMUX=y
BR2_PACKAGE_GST1_PLUGINS_GOOD_PLUGIN_ID3DEMUX=y
BR2_PACKAGE_GST1_PLUGINS_GOOD_PLUGIN_INTERLEAVE=y
BR2_PACKAGE_GST1_PLUGINS_GOOD_PLUGIN_LAW=y
BR2_PACKAGE_GST1_PLUGINS_GOOD_PLUGIN_LEVEL=y
BR2_PACKAGE_GST1_PLUGINS_GOOD_PLUGIN_MATROSKA=y
BR2_PACKAGE_GST1_PLUGINS_GOOD_PLUGIN_MULTIFILE=y
BR2_PACKAGE_GST1_PLUGINS_GOOD_PLUGIN_MULTIPART=y
BR2_PACKAGE_GST1_PLUGINS_GOOD_PLUGIN_REPLAYGAIN=y
BR2_PACKAGE_GST1_PLUGINS_GOOD_PLUGIN_RTP=y
BR2_PACKAGE_GST1_PLUGINS_GOOD_PLUGIN_RTPMANAGER=y
BR2_PACKAGE_GST1_PLUGINS_GOOD_PLUGIN_RTSP=y
BR2_PACKAGE_GST1_PLUGINS_GOOD_PLUGIN_SMPTE=y
BR2_PACKAGE_GST1_PLUGINS_GOOD_PLUGIN_UDP=y
BR2_PACKAGE_GST1_PLUGINS_GOOD_PLUGIN_VIDEOBOX=y
BR2_PACKAGE_GST1_PLUGINS_GOOD_PLUGIN_VIDEOCROP=y
BR2_PACKAGE_GST1_PLUGINS_GOOD_PLUGIN_VIDEOFILTER=y
BR2_PACKAGE_GST1_PLUGINS_GOOD_PLUGIN_VIDEOMIXER=y
BR2_PACKAGE_GST1_PLUGINS_GOOD_PLUGIN_PULSE=y
BR2_PACKAGE_GST1_PLUGINS_GOOD_PLUGIN_SOUPHTTPSRC=y
BR2_PACKAGE_GST1_PLUGINS_GOOD_PLUGIN_SPEEX=y
BR2_PACKAGE_GST1_PLUGINS_GOOD_PLUGIN_TAGLIB=y
BR2_PACKAGE_GST1_PLUGINS_GOOD_PLUGIN_VPX=y
BR2_PACKAGE_GST1_PLUGINS_BAD_PLUGIN_AUDIOMIXER=y
BR2_PACKAGE_GST1_PLUGINS_BAD_PLUGIN_COMPOSITOR=y
BR2_PACKAGE_GST1_PLUGINS_BAD_PLUGIN_AUTOCONVERT=y
BR2_PACKAGE_GST1_PLUGINS_BAD_PLUGIN_DTLS=y
BR2_PACKAGE_GST1_PLUGINS_BAD_PLUGIN_GDP=y
BR2_PACKAGE_GST1_PLUGINS_BAD_PLUGIN_ID3TAG=y
BR2_PACKAGE_GST1_PLUGINS_BAD_PLUGIN_INTER=y
BR2_PACKAGE_GST1_PLUGINS_BAD_PLUGIN_MPEGDEMUX=y
BR2_PACKAGE_GST1_PLUGINS_BAD_PLUGIN_MPEGTSDEMUX=y
BR2_PACKAGE_GST1_PLUGINS_BAD_PLUGIN_MPEGTSMUX=y
BR2_PACKAGE_GST1_PLUGINS_BAD_PLUGIN_MPEGPSMUX=y
BR2_PACKAGE_GST1_PLUGINS_BAD_PLUGIN_REMOVESILENCE=y
BR2_PACKAGE_GST1_PLUGINS_BAD_PLUGIN_RTMP=y
BR2_PACKAGE_GST1_PLUGINS_BAD_PLUGIN_SDP=y
BR2_PACKAGE_GST1_PLUGINS_BAD_PLUGIN_VIDEOPARSERS=y
BR2_PACKAGE_GST1_PLUGINS_BAD_PLUGIN_FAAD=y
BR2_PACKAGE_GST1_PLUGINS_BAD_PLUGIN_HLS=y
BR2_PACKAGE_GST1_PLUGINS_BAD_PLUGIN_MPEG2ENC=y
BR2_PACKAGE_GST1_PLUGINS_BAD_PLUGIN_OPENH264=y
BR2_PACKAGE_GST1_PLUGINS_BAD_PLUGIN_OPUS=y
BR2_PACKAGE_GST1_PLUGINS_BAD_PLUGIN_SMOOTHSTREAMING=y
BR2_PACKAGE_GST1_PLUGINS_BAD_PLUGIN_SHM=y
BR2_PACKAGE_GST1_PLUGINS_BAD_PLUGIN_SRTP=y
BR2_PACKAGE_GST1_PLUGINS_BAD_PLUGIN_WEBP=y
BR2_PACKAGE_GST1_PLUGINS_BAD_PLUGIN_WEBRTC=y
BR2_PACKAGE_GST1_PLUGINS_BAD_PLUGIN_X265=y
BR2_PACKAGE_GST1_PLUGINS_UGLY=y
BR2_PACKAGE_GST1_PLUGINS_UGLY_PLUGIN_LAME=y
BR2_PACKAGE_GST1_PLUGINS_UGLY_PLUGIN_MAD=y
BR2_PACKAGE_GST1_PLUGINS_UGLY_PLUGIN_MPEG2DEC=y
BR2_PACKAGE_GST1_PLUGINS_UGLY_PLUGIN_X264=y
BR2_PACKAGE_GST1_RPICAMSRC=y
BR2_PACKAGE_GST_OMX=y
BR2_PACKAGE_MADPLAY=y
BR2_PACKAGE_PULSEAUDIO_DAEMON=y
BR2_PACKAGE_NINJA=y
BR2_PACKAGE_CANTARELL=y
BR2_PACKAGE_DEJAVU=y
BR2_PACKAGE_GHOSTSCRIPT_FONTS=y
BR2_PACKAGE_INCONSOLATA=y
BR2_PACKAGE_LIBERATION=y
BR2_PACKAGE_WPE_LAUNCHER=y
BR2_PACKAGE_RPI_FIRMWARE=y
BR2_PACKAGE_RPI_FIRMWARE_X=y
BR2_PACKAGE_RPI_USERLAND=y
# BR2_PACKAGE_ALSA_LIB_ALISP is not set
# BR2_PACKAGE_ALSA_LIB_OLD_SYMBOLS is not set
BR2_PACKAGE_OPUS_FIXED_POINT=y
BR2_PACKAGE_TAGLIB_MP4=y
BR2_PACKAGE_GNUTLS_TOOLS=y
BR2_PACKAGE_SQLITE_STAT3=y
BR2_PACKAGE_SQLITE_ENABLE_FTS3=y
BR2_PACKAGE_SQLITE_ENABLE_UNLOCK_NOTIFY=y
BR2_PACKAGE_GRAPHENE=y
BR2_PACKAGE_LIBDRM=y
BR2_PACKAGE_LIBDRM_VC4=y
BR2_PACKAGE_PANGO=y
BR2_PACKAGE_WPE=y
BR2_PACKAGE_WPE_JSC=y
# BR2_PACKAGE_WPE_USE_ENCRYPTED_MEDIA_V1 is not set
BR2_PACKAGE_WPE_ENABLE_WEB_RTC=y
BR2_PACKAGE_DTC=y
BR2_PACKAGE_DTC_PROGRAMS=y
BR2_PACKAGE_ORC=y
BR2_PACKAGE_DROPBEAR=y
BR2_PACKAGE_GESFTPSERVER=y
BR2_PACKAGE_TCPDUMP=y
BR2_PACKAGE_WPA_SUPPLICANT=y
BR2_PACKAGE_WPA_SUPPLICANT_CLI=y
BR2_PACKAGE_HOST_DOSFSTOOLS=y
BR2_PACKAGE_HOST_GENIMAGE=y
BR2_PACKAGE_HOST_MKE2IMG=y
BR2_PACKAGE_HOST_MTOOLS=y
```

## package/llvm/Config.in
```kconfig
menuconfig BR2_PACKAGE_LLVM
	bool "llvm"
	depends on BR2_arm || BR2_armeb || BR2_aarch64 || \
		BR2_i386 || BR2_x86_64 || \
		BR2_mips || BR2_mipsel || \
		BR2_mips64 || BR2_mips64el || \
		BR2_powerpc || BR2_powerpc64 || BR2_powerpc64le || \
		BR2_sparc
	depends on BR2_INSTALL_LIBSTDCPP
	help
		The LLVM Project is a collection of modular and reusable compiler
		and toolchain technologies.

		http://llvm.org

comment "llvm requires a toolchain with C++ support"
	depends on !BR2_INSTALL_LIBSTDCPP

if BR2_PACKAGE_LLVM

config BR2_PACKAGE_LLVM_ENABLE_FFI
	bool "Support libffi"
	default n
	select BR2_PACKAGE_LIBFFI
	help
		Use libffi in the LLVM Interpreter in order to enable calling
		external functions.

config BR2_PACKAGE_LLVM_ENABLE_RTTI
	bool "C++: Support RTTI"
	default n
	help
		Enable support for C++ Run-Time Type Information (RTTI)

config BR2_PACKAGE_LLVM_ENABLE_EH
	bool "C++: Support exception handling"
	default n
	help
		Enable support for C++ exception handling (try/catch)

endif
```

## package/llvm/Config.in.host
```kconfig
menuconfig BR2_PACKAGE_HOST_LLVM
	bool "host llvm"
	depends on BR2_arm || BR2_armeb || BR2_aarch64 || \
		BR2_i386 || BR2_x86_64 || \
		BR2_mips || BR2_mipsel || \
		BR2_mips64 || BR2_mips64el || \
		BR2_powerpc || BR2_powerpc64 || BR2_powerpc64le || \
		BR2_sparc
	help
		The LLVM Project is a collection of modular and reusable compiler
		and toolchain technologies.

		http://llvm.org

if BR2_PACKAGE_HOST_LLVM

config BR2_PACKAGE_HOST_LLVM_TBLGEN_ONLY
	bool "Build only llvm-tblgen"
	help
		The llvm-tblgen tool is needed when cross-compiling LLVM for the
		target. If LLVM is not needed by any host tools, if it possible to
		select this option to speed up the build.

		NOTE: Normally LLVM builds a native llvm-tblgen as part of the normal
		build procedure. Using this option should not be normally needed, use
		it only if you know what you are doing!

endif
```

## package/smem/Config.in
```kconfig
config BR2_PACKAGE_SMEM
	bool "smem"
	help
	  Smem is a tool to generate memory usage reports on Linux
	  systems. Unlike other tools, smem can report proportional
	  set size (PSS), which is a more meaningful representation
	  of the amount of memory used by libraries and applications
	  in a virtual memory system.

	  https://www.selenic.com/smem/

if BR2_PACKAGE_SMEM

config BR2_PACKAGE_SMEM_ONLY_SMEMCAP
	bool "Build only smemcap"
	help
	  Provide only the smemcap tool to capture memory information.
	  The resulting capture files can be analyzed using smem in
	  another machine.

config BR2_PACKAGE_SMEM_ONLY_SMEMCAP_NO_PYTHON2
	bool
	default y
	depends on !BR2_PACKAGE_PYTHON2
	select BR2_PACKAGE_SMEM_ONLY_SMEMCAP

endif
```

## package/wpe/Config.in
```kconfig
source "package/wpe/dinghy/Config.in"
source "package/wpe/wpebackend/Config.in"
source "package/wpe/wpebackend-mesa/Config.in"
source "package/wpe/wpebackend-rdk/Config.in"
source "package/wpe/wpewebkit/Config.in"
```

## package/wpe/dyz-shm/Config.in
```kconfig
config BR2_PACKAGE_DYZ_SHM
	bool "dyz-shm"
	depends on BR2_PACKAGE_WPEWEBKIT
	select BR2_PACKAGE_WPEBACKEND_SHM
	help
		Dyz-SHM WPE launcher.
```

## package/wpe/wpebackend-fdo/Config.in
```kconfig
comment "wpebackend-fdo requires an EGL provider w/ Wayland-EGL, wayland"
	depends on !BR2_PACKAGE_HAS_LIBGLES || !BR2_PACKAGE_HAS_LIBEGL_WAYLAND || !BR2_PACKAGE_WAYLAND

config BR2_PACKAGE_WPEBACKEND_FDO
	bool "wpebackend-fdo"
	depends on BR2_PACKAGE_HAS_LIBEGL_WAYLAND
	depends on BR2_PACKAGE_HAS_LIBGLES
	depends on BR2_PACKAGE_WAYLAND
	help
	  Generic WPE backend which uses FreeDesktop.Org technologies.
	  In particular, it should work with any EGL drivers which
	  support the Wayland-EGL interface.

	  TODO: Public URL
```

## package/wpe/wpebackend-implementation/Config.in
```kconfig
config BR2_PACKAGE_HAS_WPEBACKEND_IMPLEMENTATION
	bool
	select BR2_PACKAGE_WPEBACKEND_FIX_SYMLINK

config BR2_PACKAGE_PROVIDES_WPEBACKEND_IMPLEMENTATION
	depends on BR2_PACKAGE_HAS_WPEBACKEND_IMPLEMENTATION
	string
```

## package/wpe/wpebackend-mesa/Config.in
```kconfig
comment "wpebackend-mesa requires mesa3d, wpebackend"
	depends on !BR2_PACKAGE_MESA3D || !BR2_PACKAGE_WPEBACKEND

config BR2_PACKAGE_WPEBACKEND_MESA
	bool "wpebackend-mesa"
	depends on BR2_PACKAGE_MESA3D
	depends on BR2_PACKAGE_WPEBACKEND
	select BR2_PACKAGE_LIBXKBCOMMON
	help
	  WPE backend which uses the Mesa3D library.

	  https://github.com/WebPlatformForEmbedded/WPEBackend-mesa

if BR2_PACKAGE_WPEBACKEND_MESA

config BR2_PACKAGE_WPEBACKEND_MESA_GBM
	bool "Use GBM for buffer sharing"
	default y
	help
	  Whether to enable support for the libgbm-based buffer sharing.

config BR2_PACKAGE_WPEBACKEND_MESA_GBM_EXPORTABLE_DMABUF
	bool "Support the dma-buf backend"
	default y
	depends on BR2_PACKAGE_WPEBACKEND_MESA_GBM

config BR2_PACKAGE_WPEBACKEND_MESA_WAYLAND_EGL
	bool "Support Wayland-EGL (EXPERIMENTAL)"
	default n
	depends on BR2_PACKAGE_HAS_LIBEGL
	depends on BR2_PACKAGE_HAS_LIBEGL_WAYLAND
	help
	  Enable experimental support for nested compositing using
	  Wayland-EGL for buffer sharing.

config BR2_PACKAGE_WPEBACKEND_MESA_TEGRA_QUIRKS
	bool "Enable quirks for Nvidia Tegra devices"
	default y if BR2_PACKAGE_NVIDIA_TEGRA23_BINARIES

endif
```

## package/wpe/wpebackend-rdk/Config.in
```kconfig
config BR2_PACKAGE_WPEBACKEND_RDK
	bool "wpebackend-rdk"
	depends on BR2_PACKAGE_RPI_USERLAND || BR2_PACKAGE_HAS_LIBEGL_WAYLAND
	depends on BR2_PACKAGE_LIBINPUT
	help
	  RDK (http://rdkcentral.con) specific implementation of the
	  WPE backend interfaces. Currently this backend can be built
	  with support the VideoCore graphics chip in the Raspberry Pi
	  (via dispmanx), or with generic support for Wayland-EGL.

	  https://github.com/WebPlatformForEmbedded/WPEBackend-rdk

if BR2_PACKAGE_WPEBACKEND_RDK

choice
	prompt "Hardware support"
	default BR2_PACKAGE_WPEBACKEND_RDK_WAYLAND_EGL if BR2_PACKAGE_HAS_LIBEGL_WAYLAND
	default BR2_PACKAGE_WPEBACKEND_RDK_BCM_RPI if BR2_PACKAGE_RPI_USERLAND

config BR2_PACKAGE_WPEBACKEND_RDK_WAYLAND_EGL
	bool "wayland-egl"
	depends on BR2_PACKAGE_HAS_LIBEGL_WAYLAND
	help
	  Build generic support using the Wayland-EGL interface.

config BR2_PACKAGE_WPEBACKEND_RDK_BCM_RPI
	bool "bcm-rpi"
	depends on BR2_PACKAGE_RPI_USERLAND
	select BR2_PACKAGE_WPEBACKEND_RDK_INPUT_LIBINPUT
	help
	  Build support for the VideoCore graphics chip present in the
	  Raspberry Pi family of devices using dispmanx.

endchoice

endif
```

## package/wpe/wpebackend-shm/Config.in
```kconfig
config BR2_PACKAGE_WPEBACKEND_SHM
	bool "wpebackend-shm"
	select BR2_PACKAGE_HAS_WPEBACKEND_IMPLEMENTATION
	#select BR2_PACKAGE_WPEBACKEND if !BR2_PACKAGE_WPEWEBKIT_ONLY_JSC
	select BR2_PACKAGE_WAYLAND
	help
		WPEBackend implementation which uses rendering buffers in shared
		memory. This backend is suitable for headless operation.

if BR2_PACKAGE_WPEBACKEND_SHM
config BR2_PACKAGE_PROVIDES_WPEBACKEND_IMPLEMENTATION
	default "wpebackend-shm"
endif
```
